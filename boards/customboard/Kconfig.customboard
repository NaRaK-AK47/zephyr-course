## boards/customboard/Kconfig.defconfig
```kconfig
if BOARD_CUSTOMBOARD

configdefault QEMU_ICOUNT_SHIFT
	default 6

config NRF_RTC_TIMER
	default n if SYS_CLOCK_EXISTS

config SYS_CLOCK_HW_CYCLES_PER_SEC
	default 1000000

config SYS_CLOCK_TICKS_PER_SEC
	default 100

endif # BOARD_CUSTOMBOARD
```

## boards/customboard/board.yml
```yaml
board:
  name: customboard
  full_name: My Custom Board
  vendor: nordic
  socs:
  - name: nrf51822
```

## boards/our_board/Kconfig.our_board
```kconfig
# QEMU Cortex-M0 board configuration

# Copyright (c) 2019 Nordic Semiconductor ASA.
# SPDX-License-Identifier: Apache-2.0

config BOARD_OUR_BOARD
	select SOC_NRF51822_QFAA
```

## boards/our_board/board.yml
```yaml
board:
  name: our_board
  full_name: Our Custom Board
  vendor: nordic
  socs:
  - name: nrf51822
```
