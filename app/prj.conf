## Kconfig
```
#choice
#    prompt "Select the LED blink rate"
#    default BLINK_SLEEP_TIME_1000MS
#
#    config BLINK_SLEEP_TIME_250MS
#        bool "Fast"
#        
#    config BLINK_SLEEP_TIME_1000MS
#        bool "Normal"
##
##    config BLINK_SLEEP_TIME_2000MS
##        bool "Slow"
##endchoice
##
##
##
##config BLINK_SLEEP_TIME_MS
##    int 
##    default 250 if BLINK_SLEEP_TIME_250MS
##    default 1000 if BLINK_SLEEP_TIME_1000MS
##    default 2000 if BLINK_SLEEP_TIME_2000MS
##    default 0
#
#menuconfig LED_SUBSYSTEM
#    bool "LED Subsystem"
#    default y
#
#    if LED_SUBSYSTEM
#
#    choice
#        prompt "Led blink sleep time"
#        default BLINK_SLEEP_TIME_1000MS
#
#        config BLINK_SLEEP_TIME_250MS
#            bool "250ms (super fast)"
#        config BLINK_SLEEP_TIME_500MS
#            bool "500ms (fast)"
#        config BLINK_SLEEP_TIME_1000MS
#            bool "1s (medium)"
#        config BLINK_SLEEP_TIME_2000MS
#            bool "2s (slow)"
#
#    endchoice
#     
#    config BLINK_SLEEP_TIME_MS
#        int 
#        default 250 if BLINK_SLEEP_TIME_250MS
#        default 500 if BLINK_SLEEP_TIME_500MS
#        default 1000 if BLINK_SLEEP_TIME_1000MS
#        default 2000 if BLINK_SLEEP_TIME_2000MS
#        default 0 
#        
#
#    menuconfig ADVANCED_LED_SUBSYSTEM
#        bool "Advanced LED settings"
#        default y
#       
#    if ADVANCED_LED_SUBSYSTEM
#
#    config LED_BRIGHTNESS
#        int "LED brightness (0-100)"
#        default 100
#        range 0 100
#        
#    config LED_FADE_DURATION
#        int "LED fade duration (ms)"
#        default 500
#        range 0 5000
#
#    menu "Expert settings"
#        visible if ADVANCED_LED_SUBSYSTEM
#    
#    config LED_DEBUGGING
#        bool "Enable LED debugging"
#        default n
#        
#    
#    config CUSTOM_BLINK_METHOD
#        bool "Custom blink pattern"
#        default n
#        
#    endmenu
#
#    endif #ADVANCED_LED_SUBSYSTEM
#endif #LED_SUBSYSTEM


config APP_HEARTBEAT_PERIOD_MS
    int "Heartbeat period (ms)"
    default 500
    range 100 2000

source "Kconfig.zephyr"
rsource "drivers/our_driver/Kconfig"
```

## prj.conf
```kconfig
CONFIG_GPIO=y
CONFIG_LOG=y
CONFIG_OUR_DRIVER=y
CONFIG_SENSOR=y
CONFIG_SHELL=y
#CONFIG_BLINK_SLEEP_TIME_250MS=y
```

## app.overlay
```dts
/{
	our_driver0: our_driver{
		compatible = "our,driver";
		led-gpios = <&gpio0 1 GPIO_ACTIVE_HIGH>;
		status = "okay"; // generates the kconfig option CONFIG_OUR_DRIVER
	};
};
```

## appold.overlay
```dts
/{
  aliases{
        app-led = &app_led0;
  };
};
```

## dts/bindings/our,driver.yaml
```yaml
description: Simple LED-as-sensor driver
compatible: "our,driver"
include: base.yaml

properties:
  led-gpios:
    type: phandle-array
    required: true
```

## src/main.cpp
```c
#include <zephyr/drivers/gpio.h>
#include <zephyr/kernel.h>
#include <zephyr/logging/log.h>
#include <zephyr/drivers/sensor.h>
#include "our_driver.h"
#define SLEEP_TIME_MS 1000

/* The devicetree node identifier for the "led0" alias. */
//#define LED_NODE DT_NODELABEL(warning_led)

//#define LED_NODE DT_ALIAS(app_led)

//#define LED_NODE DT_PATH(leds, led1)

//static const struct gpio_dt_spec led = GPIO_DT_SPEC_GET(LED_NODE, gpios);

LOG_MODULE_REGISTER(main, LOG_LEVEL_INF);

namespace{
    void test(){
        const struct device *dev = DEVICE_DT_GET(DT_NODELABEL(our_driver0));
        struct sensor_value val;
        int ret1 = sensor_sample_fetch(dev);
        k_msleep(SLEEP_TIME_MS);
        int ret2 = sensor_channel_get(dev, SENSOR_CHAN_AMBIENT_TEMP, &val);
        LOG_INF("sensor_channel_get returned = %d", ret2);
    }
}

int main(void)
{
   // test();
        
       // LOG_INF("sensor_channel_get returned = %d", ret2);
    // bool led_state = true;

    // if (!gpio_is_ready_dt(&led)) return 0;

    //if (!device_is_ready(dev)) return 0;

    const struct device *dev = DEVICE_DT_GET(DT_NODELABEL(our_driver0));
    struct sensor_value val;
    int count = 0;

    if (!device_is_ready(dev)) {
        LOG_ERR("our_driver0 not ready");
        return 0;
    }

    while (1) {
        
        if (count % 4 == 0) {
            our_driver_set_invert(dev, (count / 4) % 2, count);
        }

        sensor_sample_fetch(dev);                        /* LED ON  */
        k_msleep(SLEEP_TIME_MS);
        sensor_channel_get(dev, SENSOR_CHAN_ALL, &val);  /* LED OFF */
        k_msleep(SLEEP_TIME_MS);
        count++;
    }

    // if (gpio_pin_configure_dt(&led, GPIO_OUTPUT_ACTIVE) < 0) return 0;

    //  while (1) {

    // int ret1 = sensor_sample_fetch(dev);
    //     k_msleep(SLEEP_TIME_MS);
    //     int ret2 = sensor_channel_get(dev, SENSOR_CHAN_AMBIENT_TEMP, &val);
    //     k_msleep(SLEEP_TIME_MS);
    //     if (gpio_pin_toggle_dt(&led) < 0) return 0;

    //     led_state = !led_state;
    //     LOG_INF("LED statesssss: %s", led_state ? "ON" : "OFF");
    //     k_msleep(CONFIG_APP_HEARTBEAT_PERIOD_MS);
    return 0;
}
```
